## src/skateboard_foc_project/components/angle_sensor/Kconfig
```kconfig
menu "ANGLE_SENSOR 传感器配置"
    config ENABLE_ANGLE_SENSOR
        bool "启用 ANGLE_SENSOR 角度传感器"
        default y
        help
            启用 ANGLE_SENSOR 角度传感器功能。

    if ENABLE_ANGLE_SENSOR
        config ANGLE_SENSOR_DATA_PIN
            int "ANGLE_SENSOR SPI MISO引脚"
            default 36
            help
                ANGLE_SENSOR 传感器的SPI MISO引脚。

        config ANGLE_SENSOR_CLOCK_PIN
            int "ANGLE_SENSOR SPI CLK引脚"
            default 37
            help
                ANGLE_SENSOR 传感器的SPI CLK引脚。
    endif
endmenu
```

## src/skateboard_foc_project/components/battery_management/Kconfig
```kconfig
menu "电池管理配置"
    
    menu "电池管理测试设置"
        depends on ENABLE_UNIT_TESTS
        
        config BATTERY_TEST_CELL_COUNT
            int "测试用电池单元数量"
            default 10
            range 6 16
            help
                测试时使用的电池单元数量。

        config BATTERY_TEST_NOMINAL_VOLTAGE
            int "测试用电池标称电压 (mV)"
            default 36000
            help
                电池组标称电压，单位为毫伏。

        config BATTERY_TEST_FULL_CHARGE_VOLTAGE
            int "测试用电池满充电压 (mV)"
            default 42000
            help
                电池组满充电压，单位为毫伏。

        config BATTERY_TEST_CUTOFF_VOLTAGE
            int "测试用电池截止电压 (mV)"
            default 30000
            help
                电池组截止电压，单位为毫伏。
    endmenu

    menu "电池保护设置"
        config BATTERY_OVERCURRENT_PROTECTION
            int "过流保护电流 (mA)"
            default 30000
            help
                电池过流保护阈值，单位为毫安。

        config BATTERY_OVERTEMP_PROTECTION
            int "过温保护阈值 (°C)"
            default 45
            help
                电池过温保护阈值，单位为摄氏度。

        config BATTERY_UNDERTEMP_PROTECTION
            int "低温保护阈值 (°C)"
            default 0
            help
                电池低温保护阈值，单位为摄氏度。
    endmenu

endmenu
```

## src/skateboard_foc_project/components/communication/Kconfig
```kconfig
menu "通信配置"
    
    menu "I2C通信设置"
        config I2C_MASTER_FREQ_HZ
            int "I2C主机频率 (Hz)"
            default 100000
            range 100000 400000
            help
                I2C主机通信频率，单位为赫兹。
                标准模式为100kHz，快速模式为400kHz。

        config NFC_SDA_GPIO
            int "I2C SDA引脚GPIO编号"
            default 44
            range 0 47
            help
                I2C数据线(SDA)引脚的GPIO编号。

        config NFC_SCL_GPIO
            int "I2C SCL引脚GPIO编号"
            default 43
            range 0 47
            help
                I2C时钟线(SCL)引脚的GPIO编号。

        config I2C_TIMEOUT_MS
            int "I2C通信超时时间 (ms)"
            default 1000
            range 100 5000
            help
                I2C通信的默认超时时间，单位为毫秒。
    endmenu

    menu "CAN通信设置"
        config CAN_TX_GPIO
            int "CAN发送引脚GPIO编号"
            default 18
            range 0 47
            help
                CAN总线发送引脚的GPIO编号。

        config CAN_RX_GPIO
            int "CAN接收引脚GPIO编号"
            default 17
            range 0 47
            help
                CAN总线接收引脚的GPIO编号。
                
        config CAN_BITRATE
            int "CAN总线比特率"
            default 250000
            range 125000 1000000
            help
                CAN总线通信比特率，支持125kbps、250kbps、500kbps和1Mbps。

        config CAN_RX_TASK_STACK_SIZE
            int "CAN接收任务栈大小"
            default 4096
            range 2048 8192
            help
                CAN接收任务的栈大小，单位为字节。

        config CAN_RX_TASK_PRIORITY
            int "CAN接收任务优先级"
            default 5
            range 1 24
            help
                CAN接收任务的优先级，范围为1-24。
                
        config CAN_RX_QUEUE_SIZE
            int "CAN接收队列大小"
            default 20
            range 5 50
            help
                CAN接收消息队列的大小。
    endmenu

    menu "UART通信设置"
        config UART_RX_BUFFER_SIZE
            int "UART接收缓冲区大小"
            default 1024
            range 256 2048
            help
                UART接收缓冲区大小，单位为字节。

        config UART_TX_BUFFER_SIZE
            int "UART发送缓冲区大小"
            default 1024
            range 256 2048
            help
                UART发送缓冲区大小，单位为字节。
    endmenu

    menu "通信测试设置"
        depends on ENABLE_UNIT_TESTS
        
        config COMM_TEST_LOOPBACK
            bool "启用回环测试"
            default y
            help
                启用通信模块的回环测试。
    endmenu

endmenu
```

## src/skateboard_foc_project/components/current_sensor/Kconfig
```kconfig
menu "FOC电流传感器配置"
    config ENABLE_CURRENT_SENSOR
        bool "启用电流传感器"
        default y
        help
            启用电流传感器功能，用于FOC控制电流采样。

    if ENABLE_CURRENT_SENSOR
        menu "主电机电流传感器配置"
            config MOTOR1_CURRENT_U_ADC_CHANNEL
                int "主电机U相电流ADC通道"
                default 0
                range 0 7
                help
                    连接到主电机U相电流传感器的ADC通道号。

            config MOTOR1_CURRENT_W_ADC_CHANNEL
                int "主电机W相电流ADC通道"
                default 2
                range 0 7
                help
                    连接到主电机W相电流传感器的ADC通道号。
        endmenu

        menu "副电机电流传感器配置"
            config MOTOR2_CURRENT_U_ADC_CHANNEL
                int "副电机U相电流ADC通道"
                default 3
                range 0 7
                help
                    连接到副电机U相电流传感器的ADC通道号。

            config MOTOR2_CURRENT_W_ADC_CHANNEL
                int "副电机W相电流ADC通道"
                default 5
                range 0 7
                help
                    连接到副电机W相电流传感器的ADC通道号。
        endmenu

        menu "电流传感器校准参数"
            config CURRENT_ZERO_REFERENCE_MV
                int "电流零点参考电压 (mV)"
                default 550
                range 0 3300
                help
                    电流传感器的零点参考电压值，单位为毫伏。默认为550mV。

            config CURRENT_SCALE_FACTOR_MA_MV
                int "电流比例系数 (mA/mV)"
                default 50
                range 1 100
                help
                    电流传感器的比例系数，即每毫伏(mV)对应的电流值(mA)。

            config CURRENT_FILTER_ALPHA
                int "电流滤波系数 (x100)"
                default 50
                range 1 99
                help
                    电流读数的指数滤波系数，乘以100后的值。
                    值越小，滤波效果越强，但响应越慢。
        endmenu

        config CURRENT_ADC_WIDTH
            int "ADC位宽"
            default 12
            range 9 12
            help
                ADC转换的位宽，ESP32支持9-12位。

        config CURRENT_ADC_ATTEN
            int "ADC衰减设置"
            default 0
            range 0 3
            help
                ADC衰减设置，0对应0dB（无衰减），测量范围约0-1.1V
                1对应2.5dB，测量范围约0-1.5V
                2对应6dB，测量范围约0-2.2V
                3对应11dB，测量范围约0-3.3V
    endif
endmenu 
```

## src/skateboard_foc_project/components/gps/Kconfig
```kconfig
menu "GPS 传感器配置"
    config ENABLE_GPS
        bool "启用 GPS GPS模块"
        default y
        help
            启用 GPS GPS模块功能。

    if ENABLE_GPS
        
        config GPS_UART_PORT 
            int "GPS UART端口号"
            default 1
            help
                GPS UART端口号。            
                
        config GPS_UART_BAUD
            int "GPS UART波特率"
            default 9600
            help
                GPS UART波特率。
                
        config GPS_UART_TX_GPIO
            int "GPS UART发送引脚"
            default 17
            help
                GPS UART发送引脚。

        config GPS_UART_RX_GPIO
            int "GPS UART接收引脚"
            default 18
            help
                GPS UART接收引脚。
    endif
endmenu
```

## src/skateboard_foc_project/components/hx711/Kconfig
```kconfig
menu "HX711 传感器配置"
    config ENABLE_HX711
        bool "启用 HX711 重量传感器"
        default y
        help
            启用 HX711 称重传感器功能。

    if ENABLE_HX711
        config HX711_DATA_PIN
            int "HX711 数据引脚"
            default 36
            help
                HX711 传感器的数据引脚。

        config HX711_CLOCK_PIN
            int "HX711 时钟引脚"
            default 37
            help
                HX711 传感器的时钟引脚。
    endif
endmenu
```

## src/skateboard_foc_project/components/motor_control_foc/Kconfig
```kconfig
menu "电机控制配置"
    
    menu "FOC控制参数"
        config FOC_PWM_FREQUENCY
            int "PWM频率 (Hz)"
            default 25000
            range 15000 50000
            help
                FOC控制器PWM频率，单位为赫兹。

        config FOC_PWM_RESOLUTION_BITS
            int "PWM分辨率 (位)"
            default 10
            range 8 14
            help
                PWM分辨率，以位为单位。值越高，控制精度越高，但频率受限。

        config MOTOR_POLE_PAIRS
            int "电机极对数"
            default 10
            range 1 50
            help
                电机的极对数。必须与实际电机匹配。

        config MOTOR_MAX_CURRENT
            int "最大电机电流 (mA)"
            default 10000
            help
                电机最大允许电流，单位为毫安。
    endmenu

    menu "主电机引脚配置"
        config MOTOR_PWM_U_PIN
            int "主电机U相PWM引脚"
            default 25
            range 0 39
            help
                连接到主电机驱动U相的PWM输出引脚。

        config MOTOR_PWM_V_PIN
            int "主电机V相PWM引脚"
            default 26
            range 0 39
            help
                连接到主电机驱动V相的PWM输出引脚。

        config MOTOR_PWM_W_PIN
            int "主电机W相PWM引脚"
            default 27
            range 0 39
            help
                连接到主电机驱动W相的PWM输出引脚。
                
        config MOTOR1_HALL_A
            int "主电机Hall传感器A引脚"
            default 4
            range 0 39
            help
                连接到主电机Hall传感器A相的GPIO引脚。
                
        config MOTOR1_HALL_B
            int "主电机Hall传感器B引脚"
            default 5
            range 0 39
            help
                连接到主电机Hall传感器B相的GPIO引脚。
                
        config MOTOR1_HALL_C
            int "主电机Hall传感器C引脚"
            default 6
            range 0 39
            help
                连接到主电机Hall传感器C相的GPIO引脚。
                
        config MOTOR1_CURRENT_A
            int "主电机电流传感器A通道"
            default 0
            range 0 7
            help
                主电机电流传感器A相的ADC通道。
                
        config MOTOR1_CURRENT_B
            int "主电机电流传感器B通道"
            default 1
            range 0 7
            help
                主电机电流传感器B相的ADC通道。
    endmenu

    menu "副电机引脚配置"
        config MOTOR2_PWM_U_PIN
            int "副电机U相PWM引脚"
            default 12
            range 0 39
            help
                连接到副电机驱动U相的PWM输出引脚。

        config MOTOR2_PWM_V_PIN
            int "副电机V相PWM引脚"
            default 13
            range 0 39
            help
                连接到副电机驱动V相的PWM输出引脚。

        config MOTOR2_PWM_W_PIN
            int "副电机W相PWM引脚"
            default 14
            range 0 39
            help
                连接到副电机驱动W相的PWM输出引脚。
                
        config MOTOR2_HALL_A
            int "副电机Hall传感器A引脚"
            default 15
            range 0 39
            help
                连接到副电机Hall传感器A相的GPIO引脚。
                
        config MOTOR2_HALL_B
            int "副电机Hall传感器B引脚"
            default 16
            range 0 39
            help
                连接到副电机Hall传感器B相的GPIO引脚。
                
        config MOTOR2_HALL_C
            int "副电机Hall传感器C引脚"
            default 17
            range 0 39
            help
                连接到副电机Hall传感器C相的GPIO引脚。
                
        config MOTOR2_CURRENT_A
            int "副电机电流传感器A通道"
            default 2
            range 0 7
            help
                副电机电流传感器A相的ADC通道。
                
        config MOTOR2_CURRENT_B
            int "副电机电流传感器B通道"
            default 3
            range 0 7
            help
                副电机电流传感器B相的ADC通道。
    endmenu

    menu "电机通用配置"
        config MOTOR_ENABLE_PIN
            int "电机使能引脚(共用)"
            default 4
            range 0 39
            help
                连接到所有电机驱动使能的共用GPIO引脚。
    endmenu

    menu "控制器参数"
        config VELOCITY_PID_P
            int "速度PID-P系数 (x1000)"
            default 1200
            help
                速度环PID控制器的比例系数，乘以1000存储。

        config VELOCITY_PID_I
            int "速度PID-I系数 (x1000)"
            default 20000
            help
                速度环PID控制器的积分系数，乘以1000存储。

        config VELOCITY_PID_D
            int "速度PID-D系数 (x1000)"
            default 40
            help
                速度环PID控制器的微分系数，乘以1000存储。

        config VELOCITY_LPF_TIME_CONSTANT
            int "速度低通滤波时间常数 (x1000)"
            default 10
            help
                速度低通滤波器的时间常数，乘以1000存储。
    endmenu

    menu "电机测试设置"
        depends on ENABLE_UNIT_TESTS
        
        config MOTOR_TEST_MAX_SPEED
            int "测试最大速度百分比 (%)"
            default 50
            range 10 100
            help
                测试时使用的最大速度百分比。
    endmenu

endmenu
```

## src/skateboard_foc_project/components/nfc/Kconfig
```kconfig
menu "NFC 传感器配置"
    config ENABLE_NFC
        bool "启用 NFC NFC读卡器"
        default y
        help
            启用 NFC NFC读卡器功能。

    if ENABLE_NFC
        
        config NFC_I2C_PORT
            int "NFC I2C端口号"
            default 1
            help
                NFC I2C端口号。
                
        config NFC_I2C_ADDR
            hex "NFC I2C地址"
            default 0x28
            help
                NFC I2C地址。
                
                
    endif
endmenu
```

## src/skateboard_foc_project/components/sensors/Kconfig
```kconfig
menu "传感器配置"
    
    menu "HX711 测试配置"
        depends on ENABLE_UNIT_TESTS
        
        config HX711_TEST_DOUT_GPIO
            int "测试用 DOUT 引脚"
            default 4
            help
                测试用的 HX711 DOUT 引脚。

        config HX711_TEST_SCK_GPIO
            int "测试用 SCK 引脚"
            default 5
            help
                测试用的 HX711 SCK 引脚。
    endmenu

    menu "NFC 测试配置"
        depends on ENABLE_UNIT_TESTS
        
        config NFC_TEST_UID
            string "测试用 UID"
            default "0123456789AB"
            help
                测试用的 NFC 卡 UID。
    endmenu

endmenu
```

## src/skateboard_foc_project/main/Kconfig.projbuild
```kconfig
menu "电动滑板配置"
    
    menu "组件使能配置"
        config ENABLE_HX711
            bool "启用 HX711 重量传感器"
            default y
            help
                启用 HX711 称重传感器功能。

        config ENABLE_ANGLE_SENSOR
            bool "启用角度传感器"
            default y
            help
                启用角度传感器功能。

        config ENABLE_NFC
            bool "启用NFC功能"
            default y
            help
                启用NFC读卡器功能。

        config ENABLE_GPS
            bool "启用GPS功能"
            default y
            help
                启用GPS定位功能。

        config ENABLE_MOTOR_CONTROL_FOC
            bool "启用FOC电机控制模块"
            default y
            help
                启用FOC电机控制功能。

        config ENABLE_BATTERY_MANAGEMENT
            bool "启用电池管理模块"
            default y
            help
                启用电池管理功能，包括电量监测、充放电控制等。

        config ENABLE_COMMUNICATION
            bool "启用通信模块"
            default y
            help
                启用通信功能，包括蓝牙、CAN等通信接口。

        config ENABLE_UTILS
            bool "启用工具模块"
            default y
            help
                启用通用工具功能。
    endmenu

    config ENABLE_UNIT_TESTS
        bool "启用单元测试"
        default n
        help
            启用单元测试功能。

    config MAX_SPEED
        int "电动滑板最大速度(km/h)"
        default 25
        range 5 50
        help
            设置电动滑板的最大速度，单位为km/h

endmenu
```
